## conf/layer.conf
```bitbake
# We have a conf and classes directory, add to BBPATH
BBPATH .= ":${LAYERDIR}"

# We have recipes-* directories, add to BBFILES
BBFILES += "${LAYERDIR}/recipes-*/*/*.bb \
    ${LAYERDIR}/recipes-*/*/*.bbappend" 

BBFILE_COLLECTIONS += "embarcados"
BBFILE_PATTERN_embarcados = "^${LAYERDIR}/"
BBFILE_PRIORITY_embarcados = "6"

LAYERDEPENDS_embarcados = "qt5-layer openembedded-layer"
```

## meta-bbb/conf/layer.conf
```bitbake
# We have a conf and classes directory, add to BBPATH
BBPATH .= ":${LAYERDIR}"

# We have recipes-* directories, add to BBFILES
BBFILES += "${LAYERDIR}/recipes-*/*/*.bb \
	${LAYERDIR}/recipes-*/*/*.bbappend"

BBFILE_COLLECTIONS += "embarcados-bbb"
BBFILE_PATTERN_embarcados-bbb = "^${LAYERDIR}/"
BBFILE_PRIORITY_embarcados-bbb = "6"

LAYERDEPENDS_embarcados-bbb = "embarcados meta-ti"
```

## meta-rpi/conf/layer.conf
```bitbake
# We have a conf and classes directory, add to BBPATH
BBPATH .= ":${LAYERDIR}"

# We have recipes-* directories, add to BBFILES
BBFILES += "${LAYERDIR}/recipes-*/*/*.bb \
	${LAYERDIR}/recipes-*/*/*.bbappend"

BBFILE_COLLECTIONS += "embarcados-rpi"
BBFILE_PATTERN_embarcados-rpi = "^${LAYERDIR}/"
BBFILE_PRIORITY_embarcados-rpi = "6"

LAYERDEPENDS_embarcados-rpi = "embarcados raspberrypi"
```
